## packages/workers/images/buildroot-external/Config.in
```kconfig
source "$BR2_EXTERNAL_GARDEN_DESK_PROBE_PATH/package/garden-desk-probe-init/Config.in"
source "$BR2_EXTERNAL_GARDEN_DESK_PROBE_PATH/package/garden-desk-agent-init/Config.in"
source "$BR2_EXTERNAL_GARDEN_DESK_PROBE_PATH/package/garden-desk-node-runtime/Config.in"
source "$BR2_EXTERNAL_GARDEN_DESK_PROBE_PATH/package/garden-desk-python-libraries/Config.in"
source "$BR2_EXTERNAL_GARDEN_DESK_PROBE_PATH/package/garden-desk-antiword/Config.in"
```

## packages/workers/images/buildroot-external/configs/garden_desk_probe_aarch64_defconfig
```kconfig
BR2_aarch64=y
BR2_PACKAGE_HOST_LINUX_HEADERS_CUSTOM_6_18=y
BR2_DOWNLOAD_FORCE_CHECK_HASHES=y
BR2_REPRODUCIBLE=y
BR2_INIT_NONE=y
BR2_ROOTFS_DEVICE_CREATION_DYNAMIC_DEVTMPFS=y
BR2_SYSTEM_DHCP=""
BR2_TARGET_GENERIC_GETTY_PORT=""
BR2_LINUX_KERNEL=y
BR2_LINUX_KERNEL_CUSTOM_VERSION=y
BR2_LINUX_KERNEL_CUSTOM_VERSION_VALUE="6.18.7"
BR2_LINUX_KERNEL_USE_CUSTOM_CONFIG=y
BR2_LINUX_KERNEL_CUSTOM_CONFIG_FILE="board/qemu/aarch64-virt/linux.config"
BR2_LINUX_KERNEL_CONFIG_FRAGMENT_FILES="$(BR2_EXTERNAL_GARDEN_DESK_PROBE_PATH)/configs/linux-common.fragment $(BR2_EXTERNAL_GARDEN_DESK_PROBE_PATH)/configs/linux-aarch64.fragment"
BR2_LINUX_KERNEL_IMAGE=y
BR2_LINUX_KERNEL_NEEDS_HOST_OPENSSL=y
BR2_TARGET_ROOTFS_CPIO=y
# BR2_TARGET_ROOTFS_TAR is not set
BR2_PACKAGE_GARDEN_DESK_PROBE_INIT=y
```

## packages/workers/images/buildroot-external/configs/vault_agent_aarch64_defconfig
```kconfig
BR2_aarch64=y
BR2_PACKAGE_HOST_LINUX_HEADERS_CUSTOM_6_18=y
BR2_DOWNLOAD_FORCE_CHECK_HASHES=y
BR2_REPRODUCIBLE=y
BR2_INIT_NONE=y
BR2_ROOTFS_DEVICE_CREATION_DYNAMIC_DEVTMPFS=y
BR2_SYSTEM_DHCP=""
BR2_TARGET_GENERIC_GETTY_PORT=""
BR2_LINUX_KERNEL=y
BR2_LINUX_KERNEL_CUSTOM_VERSION=y
BR2_LINUX_KERNEL_CUSTOM_VERSION_VALUE="6.18.7"
BR2_LINUX_KERNEL_USE_CUSTOM_CONFIG=y
BR2_LINUX_KERNEL_CUSTOM_CONFIG_FILE="board/qemu/aarch64-virt/linux.config"
BR2_LINUX_KERNEL_CONFIG_FRAGMENT_FILES="$(BR2_EXTERNAL_VAULT_PROBE_PATH)/configs/linux-common.fragment $(BR2_EXTERNAL_VAULT_PROBE_PATH)/configs/linux-aarch64.fragment"
BR2_LINUX_KERNEL_IMAGE=y
BR2_LINUX_KERNEL_NEEDS_HOST_OPENSSL=y
BR2_TARGET_ROOTFS_CPIO=y
# BR2_TARGET_ROOTFS_TAR is not set
BR2_TOOLCHAIN_BUILDROOT_CXX=y
BR2_PACKAGE_PYTHON3=y
BR2_PACKAGE_PYTHON3_PY_ONLY=y
BR2_PACKAGE_PYTHON3_PYEXPAT=y
BR2_PACKAGE_PYTHON3_SQLITE=y
BR2_PACKAGE_PYTHON3_UNICODEDATA=y
BR2_PACKAGE_PYTHON3_ZLIB=y
BR2_PACKAGE_PYTHON_DEFUSEDXML=y
BR2_PACKAGE_PYTHON_LXML=y
BR2_PACKAGE_PYTHON_PILLOW=y
BR2_PACKAGE_PYTHON_TYPING_EXTENSIONS=y
BR2_PACKAGE_JPEG=y
BR2_PACKAGE_VAULT_ANTIWORD=y
BR2_PACKAGE_VAULT_NODE_RUNTIME=y
BR2_PACKAGE_VAULT_PYTHON_LIBRARIES=y
BR2_PACKAGE_VAULT_AGENT_INIT=y
```

## packages/workers/images/buildroot-external/package/garden-desk-agent-init/Config.in
```kconfig
config BR2_PACKAGE_GARDEN_DESK_AGENT_INIT
	bool "garden-desk-agent-init"
	depends on BR2_PACKAGE_PYTHON3
	help
	  Single-purpose M3 typed code-agent entrypoint.
```

## packages/workers/images/buildroot-external/package/garden-desk-antiword/Config.in
```kconfig
config BR2_PACKAGE_GARDEN_DESK_ANTIWORD
	bool "garden-desk-antiword"
	help
	  Fixed legacy Microsoft Word text reader for the M3 agent guest.
```

## packages/workers/images/buildroot-external/package/garden-desk-node-runtime/Config.in
```kconfig
config BR2_PACKAGE_GARDEN_DESK_NODE_RUNTIME
	bool "garden-desk-node-runtime"
	depends on BR2_aarch64 || BR2_x86_64
	help
	  Fixed Node.js runtime without npm or Corepack for the M3 agent guest.
```

## packages/workers/images/buildroot-external/package/garden-desk-probe-init/Config.in
```kconfig
config BR2_PACKAGE_GARDEN_DESK_PROBE_INIT
	bool "garden-desk-probe-init"
	help
	  Single-purpose M1 guest entrypoint for the bounded worker protocol probe.
```

## packages/workers/images/buildroot-external/package/garden-desk-python-libraries/Config.in
```kconfig
config BR2_PACKAGE_GARDEN_DESK_PYTHON_LIBRARIES
	bool "garden-desk-python-libraries"
	depends on BR2_PACKAGE_PYTHON3
	select BR2_PACKAGE_PYTHON_DEFUSEDXML
	select BR2_PACKAGE_PYTHON_LXML
	select BR2_PACKAGE_PYTHON_TYPING_EXTENSIONS
	help
	  Fixed pure-Python PDF, DOCX, and XLSX libraries for the M3 guest.
```

## packages/workers/images/buildroot-external/package/vault-antiword/Config.in
```kconfig
config BR2_PACKAGE_VAULT_ANTIWORD
	bool "vault-antiword"
	help
	  Fixed legacy Microsoft Word text reader for the M3 agent guest.
```

## packages/workers/images/buildroot-external/package/vault-node-runtime/Config.in
```kconfig
config BR2_PACKAGE_VAULT_NODE_RUNTIME
	bool "vault-node-runtime"
	depends on BR2_aarch64 || BR2_x86_64
	help
	  Fixed Node.js runtime without npm or Corepack for the M3 agent guest.
```
